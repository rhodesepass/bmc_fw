## main/Kconfig.projbuild
```kconfig
menu "Board pins (ePASS NEXT BMC)"

    comment "Defaults from epass_next/pcb/mainboard/bmc.kicad_sch (U10 ESP32-C3, R0.3)"
    comment "SPI uses GPIO matrix (MTMS/MTDI/MTCK/MTDO); native SPI pads NC"

    config BMC_GPIO_ESP_WAKE
        int "ESP_WAKE (XTAL_32K_P)"
        range 0 21
        default 0

    config BMC_GPIO_BAT_ADC
        int "BAT_ADC (XTAL_32K_N)"
        range 0 21
        default 1

    config BMC_GPIO_CHRG_IRQ
        int "CHRG_IRQ"
        range 0 21
        default 2

    config BMC_GPIO_APP_RESET
        int "APP_RESET"
        range 0 21
        default 3

    config BMC_GPIO_SPI_SCLK
        int "APP_TO_BMC_SCLK (MTMS)"
        range 0 21
        default 4

    config BMC_GPIO_SPI_CS
        int "APP_TO_BMC_CS (MTDI)"
        range 0 21
        default 5

    config BMC_GPIO_SPI_MOSI
        int "APP_TO_BMC_MOSI (MTCK)"
        range 0 21
        default 6

    config BMC_GPIO_SPI_MISO
        int "APP_TO_BMC_MISO (MTDO)"
        range 0 21
        default 7

    config BMC_GPIO_I2C_SCL
        int "BMC_I2C_SCL"
        range 0 21
        default 8

    config BMC_GPIO_I2C_SDA
        int "BMC_I2C_SDA"
        range 0 21
        default 9

    config BMC_GPIO_TO_APP_IRQ
        int "BMC_TO_APP_IRQ"
        range 0 21
        default 10

    config BMC_GPIO_APP_CORE_DIS
        int "APP_CORE_DIS"
        range 0 21
        default 18

    config BMC_GPIO_MAINSYS_DIS
        int "MAINSYS_DIS"
        range 0 21
        default 19

    config BMC_GPIO_UART_RX
        int "APP_UART_TX_TO_BMC_RX (U0RXD)"
        range 0 21
        default 20

    config BMC_GPIO_UART_TX
        int "BMC_UART_TX_TO_APP_RX (U0TXD)"
        range 0 21
        default 21

endmenu

menu "D1s BootROM SPI NAND"
    config BMC_SPL_NAND
        bool "Serve D1s SPL over SPI2 slave"
        default y

    config BMC_FAST_SPI_SLAVE
        bool "Fast C3 SPI slave ISR without transaction queues"
        depends on IDF_TARGET_ESP32C3
        default y

    config BMC_SPL_SLOT
        int "Active normal 128 KiB SPL slot"
        range 0 1
        default 0
endmenu

menu "BMC BLE debug and recovery"
    config BMC_BLE_DEBUG
        bool "BLE D1s console and recovery controls"
        depends on BT_NIMBLE_ENABLED && BMC_SPL_NAND
        default y

    config BMC_DEBUG_BOOT_DELAY_MS
        int "BLE recovery window before D1s boot (ms)"
        range 0 30000
        default 3000
endmenu
```

## sdkconfig.defaults
```kconfig
CONFIG_ESP_WIFI_STATIC_RX_BUFFER_NUM=4
CONFIG_ESP_WIFI_DYNAMIC_RX_BUFFER_NUM=8
CONFIG_ESP_WIFI_DYNAMIC_TX_BUFFER_NUM=8
CONFIG_ESP_WIFI_AMPDU_RX_ENABLED=n
CONFIG_ESP_WIFI_AMPDU_TX_ENABLED=n
# CONFIG_ESP_WIFI_IRAM_OPT is not set
# CONFIG_ESP_WIFI_RX_IRAM_OPT is not set
CONFIG_FREERTOS_ISR_STACKSIZE=4096
CONFIG_BOOTLOADER_CUSTOM_RESERVE_RTC=y
CONFIG_BOOTLOADER_CUSTOM_RESERVE_RTC_SIZE=0x10
CONFIG_BOOTLOADER_CUSTOM_RESERVE_RTC_IN_CRC=n
CONFIG_ESP_TASK_WDT_PANIC=y
# CONFIG_ESP_BROWNOUT_DET is not set
```
